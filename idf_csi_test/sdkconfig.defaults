## idf_csi_test/sdkconfig.defaults
```kconfig
CONFIG_ESP_WIFI_CSI_ENABLED=y
# 元祖ESP32(外付けFTDI経由の実UART)向け。S3はネイティブUSB Serial/JTAGを
# 使うため実質無関係だが、共有sdkconfigなので害はない。
# BAUDRATEの変更はESP_CONSOLE_UART_CUSTOM有効化が前提（依存関係で気付きにくい）
CONFIG_ESP_CONSOLE_UART_CUSTOM=y
CONFIG_ESP_CONSOLE_UART_BAUDRATE=115200
```
